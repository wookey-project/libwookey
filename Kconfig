## Kconfig
```kconfig
config USR_LIB_WOOKEY
  bool  "Wookey project binary IPC protocol stack"
  default y
  ---help---
  Support for binary inter-process communication for
  the wookey use case, including:
    - mass storage control plane
    - cryptographic control plane
    - user interaction control plane
```
